## src/drivers/telemetry/ct511/Kconfig
```kconfig
menuconfig DRIVERS_TELEMETRY_CT511
	bool "ct511"
	default n
	---help---
		Enable support for the DX-CT511 4G modem (TCP transparent MAVLink pipe)
```
